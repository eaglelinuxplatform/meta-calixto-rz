## conf/machine/create-calixto-image.inc
```bitbake
create_rz_image () {

CALIXTO_IMAGE_PATH_SDCARD="${DEPLOY_DIR}/../../../calixto-images/${MACHINE}/sdcard"

mkdir -p ${CALIXTO_IMAGE_PATH_SDCARD}
rm -rf ${CALIXTO_IMAGE_PATH_SDCARD}/*

cp -v ${DEPLOY_DIR_IMAGE}/bl2_bp-${MACHINE}.srec ${CALIXTO_IMAGE_PATH_SDCARD}/bl2_bp-${MACHINE}.srec

cp -v ${DEPLOY_DIR_IMAGE}/fip-${MACHINE}.srec ${CALIXTO_IMAGE_PATH_SDCARD}/fip-${MACHINE}.srec


cp ${DEPLOY_DIR}/../../../meta-calixto-rz/recipes-bsp/rz-image-flasher/create-sdcard-boot.sh ${CALIXTO_IMAGE_PATH_SDCARD}

find ${DEPLOY_DIR_IMAGE}/ -name "*.mot" -exec cp {} ${CALIXTO_IMAGE_PATH_SDCARD}/ \;

find ${DEPLOY_DIR_IMAGE}/ -name "*.rootfs.tar" -exec cp {} ${CALIXTO_IMAGE_PATH_SDCARD}/rootfs.tar \;
}

 
```

## conf/machine/include/rzg2l-common-calixto.inc
```bitbake
require conf/machine/include/${SOC_FAMILY}.inc
require conf/machine/include/rzg2-common-calixto.inc
require include/ecc-control.inc

# Firmware-pack 
EXTRA_IMAGEDEPENDS += " firmware-pack-calixto-rz"

MACHINEOVERRIDES =. "rzg2l:"

MACHINE_FEATURES_append = " bayer2raw"
```

## conf/machine/rzg2l-optima-2gb.conf
```bitbake
#@TYPE: Machine
#@NAME: rzg2l-optima-2gb machine
#@DESCRIPTION: RZ/G2L CALIXTO OPTIMA

SOC_FAMILY = "r9a07g044l"
require conf/machine/include/rzg2l-common.inc
require conf/machine/include/cip-core.inc

DEFAULTTUNE ?= "cortexa55"

TUNE_CONF ?= "conf/machine/include/tune-cortexa55.inc"
require ${TUNE_CONF}

PREFERRED_PROVIDER_virtual/kernel="linux-calixto"

UBOOT_CONFIG ??= "rzg2l-optima-2gb"
UBOOT_CONFIG[rzg2l-optima-2gb] = "rzg2l_calixto_optima_2GB_defconfig"
IMAGE_FSTYPES_remove = " tar.bz2 tar.gz"
IMAGE_FSTYPES_append = " tar"

# flash writer
EXTRA_IMAGEDEPENDS += " flash-writer-calixto-rz"

# Supported devicetree
KERNEL_DEVICETREE = " \
	renesas/rzg2l-calixto-optima.dtb \
"

IMAGE_BOOT_FILES = " \
	bl2_bp-${MACHINE}.bin \
	fip-${MACHINE}.bin \
	bl2_bp-${MACHINE}.srec \
	fip-${MACHINE}.srec \
	Flash_Writer_SCIF_${MACHINE}.mot \
"
WIC_INPUT_DEPENDS = "firmware-pack-calixto-rz:do_deploy flash-writer-calixto-rz:do_deploy"

require create-calixto-image.inc
IMAGE_POSTPROCESS_COMMAND += "create_rz_image; "
```

## conf/machine/rzg2l-versa-2gb.conf
```bitbake
#@TYPE: Machine
#@NAME: rzg2l-versa-2gb machine
#@DESCRIPTION: RZ/G2L CALIXTO VERSA

SOC_FAMILY = "r9a07g044l"
require conf/machine/include/rzg2l-common-calixto.inc
require conf/machine/include/cip-core.inc

#inherit deploy

DEFAULTTUNE ?= "cortexa55"

TUNE_CONF ?= "conf/machine/include/tune-cortexa55.inc"
require ${TUNE_CONF}

PREFERRED_PROVIDER_virtual/kernel="linux-calixto"

UBOOT_CONFIG ??= "rzg2l-versa-2gb"
UBOOT_CONFIG[rzg2l-versa-2gb] = "rzg2l_calixto_versa_2GB_defconfig"
IMAGE_FSTYPES_remove = " tar.bz2 tar.gz"
IMAGE_FSTYPES_append = " tar"

# flash writer
EXTRA_IMAGEDEPENDS += " flash-writer-calixto-rz"

# Supported devicetree
KERNEL_DEVICETREE = " \
	renesas/rzg2l-calixto-versa.dtb \
"

IMAGE_BOOT_FILES = " \
	bl2_bp-${MACHINE}.bin \
	fip-${MACHINE}.bin \
	bl2_bp-${MACHINE}.srec \
	fip-${MACHINE}.srec \
	Flash_Writer_SCIF_${MACHINE}.mot \
"
WIC_INPUT_DEPENDS = "firmware-pack-calixto-rz:do_deploy flash-writer-calixto-rz:do_deploy"

require create-calixto-image.inc
IMAGE_POSTPROCESS_COMMAND += "create_rz_image; "
```

## conf/machine/rzv2l-optima-1gb.conf
```bitbake
#@TYPE: Machine
#@NAME: rzv2l-optima-1gb machine
#@DESCRIPTION: RZ/V2L CALIXTO OPTIMA 

SOC_FAMILY = "r9a07g054l"
require conf/machine/include/rzv2l-common.inc
require conf/machine/include/cip-core.inc

DEFAULTTUNE ?= "cortexa55"

TUNE_CONF ?= "conf/machine/include/tune-cortexa55.inc"
require ${TUNE_CONF}

PREFERRED_PROVIDER_virtual/kernel="linux-calixto"

UBOOT_CONFIG ??= "rzv2l-optima-1gb"
UBOOT_CONFIG[rzv2l-optima-1gb] = "rzv2l_calixto_optima_1GB_defconfig"
IMAGE_FSTYPES_remove = " tar.bz2 tar.gz"
IMAGE_FSTYPES_append = " tar"
# flash writer
EXTRA_IMAGEDEPENDS += " flash-writer-calixto-rz"

# Supported devicetree
KERNEL_DEVICETREE = " \
	renesas/rzv2l-calixto-optima.dtb \
"

IMAGE_BOOT_FILES = " \
	bl2_bp-${MACHINE}.bin \
	fip-${MACHINE}.bin \
	bl2_bp-${MACHINE}.srec \
	fip-${MACHINE}.srec \
	Flash_Writer_SCIF_${MACHINE}.mot \
"
WIC_INPUT_DEPENDS = "firmware-pack-calixto-rz:do_deploy flash-writer-calixto-rz:do_deploy"

require create-calixto-image.inc
IMAGE_POSTPROCESS_COMMAND += "create_rz_image; "
```

## docs/template/rzv2l-versa-2gb/conf/bblayers.conf
```bitbake
# POKY_BBLAYERS_CONF_VERSION is increased each time build/conf/bblayers.conf
# changes incompatibly
POKY_BBLAYERS_CONF_VERSION = "2"

BBPATH = "${TOPDIR}"
BBFILES ?= ""

QT_LAYER = "${@os.path.isdir("${TOPDIR}/../meta-qt5")}"
RZ_FEATURE_CODEC = "${@os.path.isdir("${TOPDIR}/../meta-rz-features/meta-rz-codecs")}"
RZ_FEATURE_GRAPHICS = "${@os.path.isdir("${TOPDIR}/../meta-rz-features/meta-rz-graphics")}"
VIRTUALIZATION_LAYER = "${@os.path.isdir("${TOPDIR}/../meta-virtualization")}"

BBLAYERS ?= " \
  ${TOPDIR}/../meta-gplv2 \
  ${TOPDIR}/../poky/meta \
  ${TOPDIR}/../poky/meta-poky \
  ${TOPDIR}/../poky/meta-yocto-bsp \
  ${TOPDIR}/../meta-renesas/meta-rz-common \
  ${TOPDIR}/../meta-renesas/meta-rzg2l \
  ${TOPDIR}/../meta-openembedded/meta-oe \
  ${TOPDIR}/../meta-openembedded/meta-python \
  ${TOPDIR}/../meta-openembedded/meta-multimedia \
  ${@'${TOPDIR}/../meta-qt5' \
  if \
  '${QT_LAYER}' \
  == \
  'True' \
  else \
  ''} \
  ${@'${TOPDIR}/../meta-rz-features/meta-rz-codecs' \
  if \
  '${RZ_FEATURE_CODEC}' \
  == \
  'True' \
  else \
  ''} \
  ${@'${TOPDIR}/../meta-rz-features/meta-rz-graphics' \
  if \
  '${RZ_FEATURE_GRAPHICS}' \
  == \
  'True' \
  else \
  ''} \
  ${@'${TOPDIR}/../meta-openembedded/meta-filesystems' \
  if \
  '${VIRTUALIZATION_LAYER}' \
  == \
  'True' \
  else \
  ''} \
  ${@'${TOPDIR}/../meta-openembedded/meta-networking' \
  if \
  '${VIRTUALIZATION_LAYER}' \
  == \
  'True' \
  else \
  ''} \
  ${@'${TOPDIR}/../meta-virtualization' \
  if \
  '${VIRTUALIZATION_LAYER}' \
  == \
  'True' \
  else \
  ''} \
  /home/calixto_admin/rz-yocto/renesas-rzg2l-vlp/RTK0EF0045Z0021AZJ-v3.0.6-update3/rzg_vlp_v3.0.6/meta-calixto-rz \
  /home/calixto_admin/rz-yocto/renesas-rzg2l-vlp/RTK0EF0045Z0021AZJ-v3.0.6-update3/rzg_vlp_v3.0.6/meta-renesas/meta-rzv2l \
  "
```
